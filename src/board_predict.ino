#include <WiFi.h>
#include <stdlib.h>

/*
 Remember, kids: DON'T COMMIT YOUR OWN PASSWORD AND CLOUD IP
*/

#define WIFI_SSID
#define WIFI_PASSWORD
#define PORT
#define CLOUD_IP

#define CLOUD_PREDICTION 0x10
#define UNCERTAIN 0xFF

#define NUM_LABELS 10
#define DATA_SIZE 784
#define CONFIDENCE_THRESHOLD 0.0104

#define CLOUD_ONLY

WiFiClient client;
IPAddress server(CLOUD_IP);

byte imageData[DATA_SIZE];
byte prediction;
float confidence;

/* ENN -----------------------------------------------------------------------*/

const byte model[NUM_LABELS][DATA_SIZE] = {
    // Label 0
    { 0, 0, 0, 0, 0, 0, 0, 0, 0, 0, 0, 0, 0,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 0, 0 },
    // Label 1
    { 0, 0, 0, 0, 0, 0, 0, 0, 0, 0, 0, 0, 0,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 0, 0 },
    // Label 2
    { 0, 0, 0, 0, 0, 0, 0, 0, 0, 0, 0, 0, 1,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 0, 0 },
    // Label 3
    { 0, 0, 0, 0, 0, 0, 0, 0, 0, 0, 0, 0, 0,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 0, 0 },
    // Label 4
    { 0, 0, 0, 0, 0, 0, 0, 0, 0, 0, 0, 0, 0,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 0, 0 },
    // Label 5
    { 0, 0, 0, 0, 0, 0, 0, 0, 0, 0, 0, 0, 0,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 0, 0 },
    // Label 6
    { 0, 0, 0, 0, 0, 0, 0, 0, 0, 0, 0, 0, 2,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 0, 0 },
    // Label 7
    { 0, 0, 0, 0, 0, 0, 0, 0, 0, 0, 0, 0, 0,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 0, 0 },
    // Label 8
    { 0, 0, 0, 0, 0, 0, 0, 0, 0, 0, 0, 0, 0,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 0, 0 },
    // Label 9
    { 0, 0, 0, 0, 0, 0, 0, 0, 0, 0, 0, 0, 0,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 0, 0 },
};

/* PREDICTION ----------------------------------------------------------------*/

void predictOnCloud()
{
    if ( client.connected() )
    {
        client.write(imageData, DATA_SIZE);
        while ( !client.available() ) {}
        prediction = client.read();
        prediction |= CLOUD_PREDICTION;
    }
}

void predictOnBoard()
{
    unsigned int response[NUM_LABELS] = {};
    unsigned int minResponse = 65535;
    unsigned int secondMinResponse = 65535;

    for ( unsigned int i=0; i<DATA_SIZE; i++ )
        for ( byte l=0; l<NUM_LABELS; l++ )
            response[l] += abs(imageData[i] - model[l][i]);

    for ( byte l=0; l<NUM_LABELS; l++ )
    {
        if ( response[l] < minResponse )
        {
            prediction = l;
            secondMinResponse = minResponse;
            minResponse = response[l];
        }
        else if ( response[l] < secondMinResponse )
        {
            secondMinResponse = response[l];
        }
    }
    
    confidence = 1.0 - ((float)minResponse/(float)secondMinResponse);
}

/* BOARD ---------------------------------------------------------------------*/

void setup() 
{
    pinMode(LED_BUILTIN, OUTPUT);

    Serial.begin(115200);
    while ( !Serial ) {}

    WiFi.begin(WIFI_SSID, WIFI_PASSWORD);
    while ( WiFi.status() != WL_CONNECTED ) {}
    while ( !client.connect(server, PORT) ) {}
    digitalWrite(LED_BUILTIN, HIGH);
}

void loop() 
{
    if ( Serial.available() ) 
    {
        prediction = UNCERTAIN;
        Serial.readBytes(imageData, DATA_SIZE);
#ifndef CLOUD_ONLY
        predictOnBoard();
        if ( confidence < CONFIDENCE_THRESHOLD )
#endif
            predictOnCloud();
        Serial.write(prediction);
    }
    if ( !client.connected() ) 
    {
        client.stop();
        digitalWrite(LED_BUILTIN, LOW);
        while ( !client.connect(server, PORT) ) {}
        digitalWrite(LED_BUILTIN, HIGH);
    }
}
